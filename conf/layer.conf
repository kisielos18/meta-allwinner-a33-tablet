## conf/layer.conf
```bitbake
# We have a conf and classes directory, add to BBPATH
BBPATH .= ":${LAYERDIR}"

# We have recipes-* directories, add to BBFILES
BBFILES += "${LAYERDIR}/recipes-*/*/*.bb \
            ${LAYERDIR}/recipes-*/*/*.bbappend"

BBFILE_COLLECTIONS += "meta-allwinner-a33"
BBFILE_PATTERN_meta-allwinner-a33 = "^${LAYERDIR}/"
BBFILE_PRIORITY_meta-allwinner-a33 = "6"

LAYERDEPENDS_meta-allwinner-a33 = "core"
LAYERSERIES_COMPAT_meta-allwinner-a33 = "mickledore"
```

## conf/machine/allwinner-a33.inc
```bitbake
#@TYPE: Machine
#@NAME: sun8i
#@NEEDED_BSPLAYERS: layers/meta-openembedded/meta-oe layers/meta-openembedded/meta-python

include conf/machine/include/soc-family.inc
```

## conf/machine/sun8i-a33-tablet.conf
```bitbake
# Allwinner BSP a33 tablet defaults

#DEFAULTTUNE = "cortexa7t-neon"
include allwinner-a33.inc
# =========================================================================
# Chip architecture
# =========================================================================
DEFAULTTUNE = "cortexa7thf-neon"
include conf/machine/include/arm/armv7a/tune-cortexa7.inc

PREFERRED_PROVIDER_virtual/kernel ??= "linux-lime2"
PREFERRED_VERSION_linux-lime2= "4.18"

#REFERRED_PROVIDER_u-boot-default-script ??= "sunxi-u-boot-scr"

#SOC_FAMILY = "allwinner"

SDIMG_KERNELIMAGE  ?= "kernel.img"
#UBOOT_MACHINE = "sunxi_config"
SERIAL_CONSOLES ?= "115200;ttyAMA0"

KERNEL_DEVICETREE = "sun8i-a33-q8-tablet.dts"

KERNEL_IMAGETYPE = "zImage"
```
